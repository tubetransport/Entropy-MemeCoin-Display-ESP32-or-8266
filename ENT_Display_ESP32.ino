#include <Arduino.h>
#include <ArduinoJson.h>
#include <Wire.h>                  // For I2C communication
#include <Adafruit_GFX.h>           // Core graphics library
#include <Adafruit_SSD1306.h>       // SSD1306 OLED library
#include <WiFi.h>
#include <HTTPClient.h>  




#define SCREEN_WIDTH 128            
#define SCREEN_HEIGHT 64             
#define OLED_RESET    -1             // Reset pin not used
#define OLED_ADDR      0x3C          // I2C address of the OLED display



Adafruit_SSD1306 display(SCREEN_WIDTH, SCREEN_HEIGHT, &Wire, OLED_RESET);

// Replace with your network credentials
const char* ssid = "YOUR SSID";
const char* password = "YOUR PASSWORD";

// Entropy Coin price API endpoint
const char* coinPriceURL = "https://api.geckoterminal.com/api/v2/simple/networks/solana/token_price/ENTxR2RP8NtvhXzMNFCxE1HazzdV9x7SuZqGyAb4jdED";

//ENT Spashscreen 128x64
const uint8_t bmpImage[] PROGMEM = {

0x00, 0x00, 0x00, 0x00, 0x00, 0x00, 0x00, 0x3f, 0xfc, 0x00, 0x00, 0x00, 0x00, 0x00, 0x00, 0x00, 
	0x00, 0x00, 0x00, 0x00, 0x00, 0x00, 0x03, 0xff, 0xff, 0xc0, 0x00, 0x00, 0x00, 0x00, 0x00, 0x00, 
	0x00, 0x00, 0x00, 0x00, 0x00, 0x00, 0x1f, 0xff, 0xff, 0xf8, 0x00, 0x00, 0x00, 0x00, 0x00, 0x00, 
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	0x00, 0x00, 0x00, 0x00, 0x00, 0x00, 0x00, 0xff, 0xff, 0x00, 0x00, 0x00, 0x00, 0x00, 0x00, 0x00
};


void setup() {
  // Initialize serial communication
  Serial.begin(9600);

  // Initialize the OLED display
  if(!display.begin(SSD1306_SWITCHCAPVCC, OLED_ADDR)) {
    Serial.println(F("SSD1306 allocation failed"));
    for(;;);
  }

  // Show the ENT splash screen.
  display.clearDisplay();
  display.drawBitmap(0, 0, bmpImage, 128, 64, WHITE);  // Adjust dimensions if needed
  
  display.display();
  delay(2000); // Pause for 2 seconds

  // Clear the buffer
  display.clearDisplay();

  // Connect to Wi-Fi
  WiFi.begin(ssid, password);
  Serial.print("Connecting to ");
  Serial.print(ssid);

  while (WiFi.status() != WL_CONNECTED) {
    delay(500);
    Serial.print(".");
  }
  Serial.println(" connected");



  // Fetch and display coin price
  fetchAndDisplayPrice();
}

void loop() {
  // Update every minute
  delay(60000);
  fetchAndDisplayPrice();
}




void fetchAndDisplayPrice() {

// Make HTTPS request
  if (WiFi.status() == WL_CONNECTED) {
    HTTPClient http;

    http.begin(coinPriceURL); 
    int httpCode = http.GET(); 
    String payload = http.getString();
      Serial.println("Response code: " + String(httpCode));
      Serial.println("Response payload: " + payload);
    
    
 // Create a DynamicJsonDocument object
DynamicJsonDocument doc(1024);  

//Deserialize the JSON document
DeserializationError error = deserializeJson(doc, payload);
 //Test if parsing succeeds.
  if (error) {
    Serial.print(F("deserializeJson() failed: "));
    Serial.println(error.f_str());
    return;
  }
 // Extract the Entropy price
float price = doc ["data"]["attributes"]["token_prices"]["ENTxR2RP8NtvhXzMNFCxE1HazzdV9x7SuZqGyAb4jdED"];

Serial.println(price, 10);


//Entropy thumbnail image
static const unsigned char PROGMEM Entropy_Thumbnail[] =
{
	0x00, 0x0f, 0xf0, 0x00, 0x00, 0x7f, 0xfe, 0x00, 0x01, 0xff, 0xff, 0x80, 0x03, 0xff, 0xff, 0xc0, 
	0x07, 0xff, 0xff, 0xe0, 0x0f, 0xff, 0xff, 0xf0, 0x1f, 0xff, 0x6f, 0xf8, 0x3f, 0xfe, 0x2f, 0xfc, 
	0x3f, 0xe2, 0x0f, 0xfc, 0x7f, 0x20, 0x07, 0xfe, 0x7f, 0x03, 0x07, 0xfe, 0x7f, 0x83, 0x87, 0xff, 
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	0x03, 0xff, 0xff, 0xc0, 0x01, 0xff, 0xff, 0x80, 0x00, 0x7f, 0xfe, 0x00, 0x00, 0x1f, 0xf8, 0x00
};
 

  //Display the price on the OLED
  display.clearDisplay();
  display.drawBitmap(0, 0, Entropy_Thumbnail, 32, 32, WHITE);
  display.setTextColor(SSD1306_WHITE);
  display.setTextSize(4);
  display.setCursor(39, 6);
  display.print("ENT");
  display.setTextSize(2);
  display.setCursor(0, 42);
  display.print("$");
  display.print(price, 7);
  display.display();
  }
}






